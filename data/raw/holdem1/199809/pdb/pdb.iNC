iNC       906520645 10  4 f   -     -     -         1000    0    0 
iNC       906520715 10  3 c   k     bc    b         1000   70    0 Js Kc
iNC       906520833 10  2 Bf  -     -     -          930   10    0 
iNC       906520873 10  1 Bc  kc    kc    b          920   80    0 6d 7h
iNC       906520929 10 10 c   c     f     -          840   30    0 
iNC       906520982 10  9 c   b     b     r          810   80    0 5s 6d
iNC       906521042 10  8 c   b     b     rc         730  100    0 2h 9h
iNC       906521130 10  7 cc  cc    c     c          630   80    0 8h 4c
iNC       906521214 10  6 c   b     b     b          550   60    0 Qh 8h
iNC       906521286 10  5 Q   -     -     -          490    0    0 
